/*
 * custom_math.c
 *
 * Created: 26.04.2018 19:47:35
 *  Author: Pawel
 */

#include <avr/pgmspace.h>
#include <stdlib.h>
#include <math.h>
#include <util/delay.h>
#include "custom_math.h"
#include "rs232/rs232.h"



extern int16_t samples[1024];

// table with quarter of sinus (0-pi/2)
const int16_t sin_tab[256] PROGMEM = {
	0,    201,    402,    603,    804,   1005,   1206,   1406,
	1607,   1808,   2009,   2209,   2410,   2610,   2811,   3011,
	3211,   3411,   3611,   3811,   4011,   4210,   4409,   4608,
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	32727,  32736,  32744,  32751,  32757,  32761,  32764,  32767,
};
		

// time windows tables
const int16_t hanning_table[1024] PROGMEM = {
	0,     0,     1,     2,     4,     7,     11,    15,    19,    25,    30,
	37,    44,    52,    60,    69,    79,    89,    100,   111,   123,   136,
	149,   163,   177,   192,   208,   224,   241,   259,   277,   296,   315,
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	37,    30,    25,    19,    15,    11,    7,     4,     2,     1,     0,
	0};	
	
const int16_t PROGMEM hamming_table[1024] = {
	2513,  2514,  2515,  2516,  2518,  2521,  2524,  2527,  2532,  2537,  2542,
	2548,  2555,  2562,  2569,  2578,  2586,  2596,  2606,  2616,  2627,  2639,
	2651,  2664,  2678,  2691,  2706,  2721,  2737,  2753,  2770,  2787,  2805,
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	2548,  2542,  2537,  2532,  2527,  2524,  2521,  2518,  2516,  2515,  2514,
	2513};	

const int16_t triangle_table[1024] PROGMEM = {
	64,    128,   192,   256,   320,   384,   448,   512,   576,   640,   704,
	768,   832,   896,   960,   1024,  1088,  1152,  1216,  1280,  1344,  1408,
	1472,  1536,  1600,  1664,  1728,  1792,  1856,  1920,  1984,  2048,  2112,
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	0,
};

const int16_t flat_top_table[1024] PROGMEM = {
	0,     0,     0,     0,     0,     0,     -1,    -1,    -1,    -2,    -2,
	-3,    -4,    -4,    -5,    -6,    -7,    -8,    -9,    -10,   -11,   -13,
	-14,   -15,   -17,   -19,   -20,   -22,   -24,   -26,   -28,   -30,   -32,
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	-3,    -2,    -2,    -1,    -1,    -1,    0,     0,     0,     0,     0,
0};


// special low flash, ram and cpu cycles requirement functions
// input: k - angle in format: (k/1024)*2*PI
// output: value of sin/cos function multiplied by 32767
int16_t sinus(int k) {
  // find half of sin (sin(x+pi)=-sin(x))
  int8_t s = 1;
  while (k > 511) {
    s = -s;
    k -= 512;
  }
  // find quater and return val (sin(k)=sin(pi-k),kE<0,pi/2>)
  if (k < 256) {
    return s * (int16_t)pgm_read_word(&sin_tab[k]);
  } else {
    return s * (int16_t)pgm_read_word(&sin_tab[511 - k]);
  }
}

int16_t cosinus(int k) {
  // cos(x)=sin(x+pi/2)
  return sinus(k + 256);
}

// function to scaling probes when fft is computing
// input: a - Wx core from fft algorithm butterfly
// b - current value of sample
// output: scaled sample value
static int16_t fix_mpy(int16_t a, int16_t b) {
  // shift right one less bit (i.e. 15-1)
  int32_t c = ((int32_t)a * (int32_t)b) >> 14;
  // last bit shifted out = rounding-bit
  b = c & 0x01;
  // last shift + rounding bit
  a = (c >> 1) + b;
  return a;
}

// function to calc complex fast fourier transform
// input: fr[n],fi[n] are re and im array of probes
// m - log2(number of probes)
// output: the result lands in this same arrays
void fix_fft(int16_t fr[], int16_t fi[], int16_t m) {
  int32_t mr, nn, i, j, l, k, istep, n, shift;
  int16_t qr, qi, tr, ti, wr, wi;
  n = 1 << m;
  mr = 0;
  nn = n - 1;
  // DIT - decimation in time
  // first replace probes positions
  for (m = 1; m <= nn; ++m) {
    l = n;
    do {
      l >>= 1;
    } while (mr + l > nn);
    mr = (mr & (l - 1)) + l;

    if (mr <= m)
      continue;
    tr = fr[m];
    fr[m] = fr[mr];
    fr[mr] = tr;
    ti = fi[m];
    fi[m] = fi[mr];
    fi[mr] = ti;
  }

  l = 1;
  k = 10 - 1;
  // fft alghoritm
  while (l < n) {
    shift = 1;
    istep = l << 1;
    for (m = 0; m < l; ++m) { // first stage
      j = m << k;
      wr = cosinus(j); // calc initial core values
      wi = -sinus(j);
      if (shift) {
        wr >>= 1;
        wi >>= 1;
      }
      for (i = m; i < n; i += istep) { // second stage
        j = i + l;
        // calc single butterfly
        tr = fix_mpy(wr, fr[j]) - fix_mpy(wi, fi[j]);
        ti = fix_mpy(wr, fi[j]) + fix_mpy(wi, fr[j]);
        qr = fr[i];
        qi = fi[i];
        if (shift) {
          qr >>= 1;
          qi >>= 1;
        }
        fr[j] = qr - tr;
        fi[j] = qi - ti;
        fr[i] = qr + tr;
        fi[i] = qi + ti;
      }
    }
    --k;
    l = istep;
  }
}

// function to calc real fast fourier transform
// input: f[] - array of real input probes
// m - log2(number of probes)
// output: the result lands in the same array

void fix_fftr(int16_t f[], int m) {
  int32_t i, N = 1 << (m - 1);
  // sort probes by even/odd
  int16_t tt, *fr = f, *fi = &f[N];
  for (i = 1; i < N; i += 2) {
    tt = f[N + i - 1];
    f[N + i - 1] = f[i];
    f[i] = tt;
  }
  // submit with N/2 points
  fix_fft(fi, fr, m - 1);
}

// calc square root of 32bit integer, based on
// AN FPGA IMPLEMENTATION OF FIXED-POINT SQUARE ROOT OPERATION
// K.PIROMSOPA, C.APORNTEWAN, P.CHONGSATITVANTA
// input: n - the number of which is calculated root
// output: result
uint16_t square_root(uint32_t x) {
  uint32_t op, res, one;

  op = x;
  res = 0;

  // "one" starts at the highest power of four <= than the argument.
  one = ((uint32_t)1 << 30); // second-to-top bit set
  while (one > op)
    one >>= 2;

  while (one != 0) {
    if (op >= res + one) {
      op -= res + one;
      res += one << 1; // <-- faster than 2 * one
    }
    res >>= 1;
    one >>= 2;
  }
  return res;
}

// function to calc magnitude of complex samples
// input: f[] - array of sample where first k/2 probes
// are re part of sample, and second half are im part
// k-number of samples
// function is working only with fix_fftr function
// thats not normal magnitude algorithm
void fix_fft_mag(int16_t f[], int16_t k) {
  // offset
  int32_t tmp;
  tmp = pow(f[0], 2);
  tmp += pow(f[k / 2], 2);
  tmp /= 2;
  tmp = sqyare_root(tmp);
  f[0] = tmp;
  // harmonics
  for (int16_t i = 1; i < k / 2; i++) {
    tmp = pow(f[i] * 2, 2);
    tmp += pow(f[i + (k / 2)] * 2, 2);
    tmp /= 2;
    f[i] = square_root(tmp);
  }
}

// window multiplication function
// input: val - value of probe, w - windows type
// idx - index of probe
// output - the result of multiplication

int16_t window(int16_t val, int8_t w, int16_t idx) {
  int32_t temp = val;
  if (w == 0)
    ;           // RECTANGLE
  if (w == 1) { // HANNING
    temp *= (int16_t)pgm_read_word(&hanning_table[idx]);
    temp >>= 15;
  }
  if (w == 2) { // HAMMING
    temp *= (int16_t)pgm_read_word(&hamming_table[idx]);
    temp >>= 15;
  }
  if (w == 3) { // TRIANGLE
    temp *= (int16_t)pgm_read_word(&triangle_table[idx]);
    temp >>= 15;
  }
  if (w == 4) { // FLAT TOP
    temp *= (int16_t)pgm_read_word(&flat_top_table[idx]);
    temp /= (1 << 13);
  }
  return (int16_t)temp;
}

// Test functions
void fill_test_sinus(int h) {
  for (int i = 0; i < 1024; i++) {
    samples[i] = sinus(2 * h * i) / 128;
  }
}

void fill_test_saw(void) {
  for (int i = 0; i < 256; i++) {
    samples[i] = i * 2;
  }
  for (int i = 0; i < 256; i++) {
    samples[i + 256] = i * 4;
  }
  for (int i = 0; i < 256; i++) {
    samples[i + 512] = i * 4;
  }
  for (int i = 0; i < 256; i++) {
    samples[i + 768] = i * 4;
  }
}

void fill_test_square(void) {
  for (int i = 0; i < 256; i++) {
    samples[i] = 768;
  }
  for (int i = 256; i < 512; i++) {
    samples[i] = 0;
  }
  for (int i = 512; i < 768; i++) {
    samples[i] = 768;
  }
  for (int i = 768; i < 1024; i++) {
    samples[i] = 0;
  }
}

void fill_random_signal(void) {
  for (uint16_t a = 0; a < 1024; a++) {
    samples[a] = 0;
    for (uint8_t b = 0; b < 10; b++) {
      samples[a] |= ((ADCW & 1) << b);
      _delay_us(5);
    }
  }
}
